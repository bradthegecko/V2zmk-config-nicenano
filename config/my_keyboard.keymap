#include <behaviors.dtsi>
#include <dt-bindings/zmk/keys.h>
#include <dt-bindings/zmk/bt.h>
#include <dt-bindings/zmk/ext_power.h>

/ {
    keymap {
        compatible = "zmk,keymap";

        default_layer {
            bindings = <
                &bt BT_CLR_ALL    // Clears Bluetooth bonds
                &ext_power EP_ON  // Forces VCC to 3.3V
            >;
        };
    };
};
